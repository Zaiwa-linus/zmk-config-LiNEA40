## app/Kconfig
```kconfig
# Copyright (c) 2024 The ZMK Contributors
# SPDX-License-Identifier: MIT

config ZMK_BEHAVIOR_BT_LAYER
    bool "BT Profile Layer Behavior"
    default n
    depends on ZMK_BLE
    depends on !ZMK_SPLIT || ZMK_SPLIT_ROLE_CENTRAL
    help
      Enable behavior that combines BT profile selection with layer switching.
      When a BT profile is selected, the corresponding layer is automatically activated.
```

## app/dts/bindings/behaviors/zmk,behavior-bt-layer.yaml
```yaml
# Copyright (c) 2024 The ZMK Contributors
# SPDX-License-Identifier: MIT

description: BT Profile Layer Behavior

compatible: "zmk,behavior-bt-layer"

include: one_param.yaml
```

## config/app/Kconfig
```kconfig
config ZMK_BEHAVIOR_BT_LAYER
    bool "BT Profile Layer Behavior"
    default y
    depends on ZMK_BLE
    depends on !ZMK_SPLIT_ROLE_PERIPHERAL
    help
      Enable BT Profile Layer Behavior which combines Bluetooth profile
      selection with automatic layer switching.
```

## config/app/dts/bindings/behaviors/zmk,behavior-bt-layer.yaml
```yaml
description: Bluetooth Profile Layer Behavior

compatible: "zmk,behavior-bt-layer"

include: one_param.yaml

properties:
  "#binding-cells":
    const: 1
  layer-profile-1:
    type: int
    default: 1
    description: Layer to enable when profile 1 is selected
  layer-profile-2:
    type: int
    default: 2
    description: Layer to enable when profile 2 is selected
```
