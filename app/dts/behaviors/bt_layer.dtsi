/*
 * Copyright (c) 2024 The ZMK Contributors
 *
 * SPDX-License-Identifier: MIT
 */

/ {
    behaviors {
        /omit-if-no-ref/ bt_layer: bt_layer {
            compatible = "zmk,behavior-bt-layer";
            #binding-cells = <1>;
        };
    };
};
