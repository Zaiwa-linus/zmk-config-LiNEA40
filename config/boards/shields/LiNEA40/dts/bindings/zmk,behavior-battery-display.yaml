## config/boards/shields/LiNEA40/dts/bindings/zmk,behavior-battery-display.yaml
```yaml
description: |
  Type battery percentage as HID keystrokes.
  Outputs "L:XX% R:XX%" where L=left(peripheral) and R=right(central).
  Each keystroke has a 30ms inter-key delay for BLE reliability.

compatible: "zmk,behavior-battery-display"

include: zero_param.yaml
```

## config/boards/shields/LiNEA40/dts/bindings/zmk,behavior-bt-base.yaml
```yaml
description: Select Bluetooth profile and return to the base layer

compatible: "zmk,behavior-bt-base"

include: one_param.yaml
```

## config/boards/shields/LiNEA40/dts/bindings/zmk,behavior-bt-layer.yaml
```yaml
description: Select Bluetooth profile and activate the matching layer

compatible: "zmk,behavior-bt-layer"

include: one_param.yaml
```

## modules/custom_battery_typist/Kconfig
```kconfig
config CUSTOM_BATTERY_TYPIST
    bool "Enable battery level typing behavior"
    default y
    depends on ZMK_BATTERY_REPORTING
```
